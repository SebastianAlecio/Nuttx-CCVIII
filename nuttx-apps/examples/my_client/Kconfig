## nuttx-apps/examples/my_client/Kconfig
```kconfig
#
# apps/examples/my_client/Kconfig
#

config EXAMPLES_MY_CLIENT
	bool "My Network Client Example"
	default n
	# Depende de que el soporte de red (NET) y el soporte de sockets TCP (NET_TCP) estén activos.
	depends on NET_TCP 
	---help---
		Enable the my_client application to test TCP/UDP connectivity.

if EXAMPLES_MY_CLIENT

# Tamaño de pila del programa
config EXAMPLES_MY_CLIENT_STACKSIZE
	int "my_client stack size"
	default DEFAULT_TASK_STACKSIZE
	---help---
		Stack size of the "my_client" command.

# Opciones de conectividad directa

config EXAMPLES_MY_CLIENT_TARGET_IP
	hex "Target Server IP address"
	default 0x7f000001  # ip 127.0.0.1 
	---help---
		The IP address of the server that the client will connect to.

config EXAMPLES_MY_CLIENT_PORT
	int "Target Server Port number"
	default 3000  # puerto 3000
	---help---
		The port number of the server that the client will connect to.

endif
```

## nuttx-apps/examples/my_client_raw/Kconfig
```kconfig
#
# Kconfig para el cliente de Raw Sockets (my_client_raw)
#

config EXAMPLES_MY_CLIENT_RAW
	tristate "Encabezados UDP/IP LAB7"
	default n
	# depends on NET_IPv4 && NET_RAW && NET_UDP && NET_ICMP
	---help---
		Activa el ejemplo 'my_client_raw'.
		Este cliente construye manualmente los encabezados IP y UDP
		para comunicarse con 'my_server'.

		Necesita:
		- NET_IPv4: Soporte para IPv4.
		- NET_RAW: Soporte para Raw Sockets.
		- NET_UDP: Para el protocolo y para que el kernel calcule el checksum.
		- NET_ICMP: Para que el socket raw pueda recibir errores.

if EXAMPLES_MY_CLIENT_RAW

config EXAMPLES_MY_CLIENT_RAW_STACKSIZE
	int "Tamaño del Stack para my_client_raw"
	default 2048
	---help---
		Los sockets raw y el parseo de paquetes usan más stack.

config EXAMPLES_MY_CLIENT_RAW_TARGET_IP
	string "IP por defecto del Servidor"
	default "127.0.0.1"
	---help---
		La dirección IP por defecto a la que se conectará el cliente raw.
		Usa 127.0.0.1 para pruebas locales (loopback).

config EXAMPLES_MY_CLIENT_RAW_PORT
	int "Puerto por defecto del Servidor"
	default 3000
	---help---
		El puerto por defecto al que se conectará el cliente raw.
		Debe coincidir con el puerto de 'my_server'.

endif
```

## nuttx-apps/examples/my_server/Kconfig
```kconfig
#
# Para una descripción de la sintaxis de este archivo de configuración,
# vea el archivo kconfig-language.txt en el repositorio de herramientas de NuttX.
#

config EXAMPLES_MY_SERVER
	tristate "My server lab1"
	default n
	# Depende de que la red (NET) y ambos protocolos (TCP y UDP) estén habilitados
	depends on NET && NET_TCP && NET_UDP
	---help---
		Habilita el ejemplo del servidor (my_server).
		Este servidor puede operar en modo TCP o UDP.

if EXAMPLES_MY_SERVER

config EXAMPLES_MY_SERVER_STACKSIZE
	int "Tamaño del stack para my_server"
	default DEFAULT_TASK_STACKSIZE
	---help---
		Tamaño del stack para el comando "my_server".
		Si se usa en un entorno de red muy ocupado, podría necesitar
		aumentar este valor (ej. 4096).

config EXAMPLES_MY_SERVER_PORT
	int "Puerto por defecto del servidor"
	default 3000
	---help---
		El puerto en el que el servidor escuchará por defecto.
		Esto puede ser sobreescrito por el argumento "port" en NSH.

endif
```

## nuttx-apps/examples/raw_client/Kconfig
```kconfig
#
# For a description of the syntax of this configuration file,
# see the file kconfig-language.txt in the NuttX tools repository.
#

config EXAMPLES_RAWCLIENT
	tristate "Raw UDP socket client"
	default n
	#depends on NET_RAW
	---help---
		Enable the raw UDP socket client example.

config EXAMPLES_RAWCLIENT_STACKSIZE
	int "raw_client stack size"
	default 2048
	#depends on EXAMPLES_RAWCLIENT
	---help---
		Stack size for the "raw_client" command.
		The default of 2048 should be sufficient as it
		does not use deep recursion or large stack variables.
```
